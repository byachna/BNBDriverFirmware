## master_node/main/Kconfig.projbuild
```kconfig
menu "Wardrive Master Node (ESP32-WROOM-32E) Configuration"

    config WD_BLE_DEVICE_NAME
        string "BLE device name advertised to phone"
        default "BNB-WarDriver"

    config WD_MASTER_UART_PORT_NUM
        int "UART port number (link to local ESP32-C5)"
        default 1
        range 0 2

    config WD_MASTER_UART_TX_GPIO
        int "UART TX GPIO (wire to C5 RX)"
        default 17

    config WD_MASTER_UART_RX_GPIO
        int "UART RX GPIO (wire to C5 TX)"
        default 16

    config WD_MASTER_UART_BAUD
        int "UART baud rate"
        default 921600

    config WD_MASTER_ESPNOW_CHANNEL
        int "ESP-NOW Wi-Fi channel"
        default 1
        range 1 13
        help
            Fixed channel used to talk to wireless ESP32-C5 child nodes.

endmenu
```

## master_node/sdkconfig.defaults
```kconfig
CONFIG_IDF_TARGET="esp32"

CONFIG_ESPTOOLPY_FLASHSIZE_4MB=y
CONFIG_PARTITION_TABLE_CUSTOM=y
CONFIG_PARTITION_TABLE_CUSTOM_FILENAME="partitions.csv"

CONFIG_BT_ENABLED=y
CONFIG_BT_NIMBLE_ENABLED=y
CONFIG_BT_BLUEDROID_ENABLED=n
CONFIG_BT_NIMBLE_MAX_CONNECTIONS=1
CONFIG_BT_NIMBLE_ROLE_CENTRAL_DISABLED=y
CONFIG_BT_NIMBLE_ROLE_OBSERVER_DISABLED=y

CONFIG_FREERTOS_HZ=1000
```

## wifi_scanner_c5/main/Kconfig.projbuild
```kconfig
menu "Wardrive Scanner (ESP32-C5) Configuration"

    choice WD_TRANSPORT
        prompt "Link to master node"
        default WD_TRANSPORT_ESPNOW
        help
            How this scanner node talks to the ESP32-WROOM-32E master.
            Use UART for the single scanner wired directly to the master's
            TX/RX pins. Use ESP-NOW for additional wireless scanner nodes
            that get assigned Wi-Fi channels over the air.

        config WD_TRANSPORT_UART
            bool "UART (wired directly to master)"

        config WD_TRANSPORT_ESPNOW
            bool "ESP-NOW (wireless child node)"
    endchoice

    config WD_UART_PORT_NUM
        int "UART port number"
        depends on WD_TRANSPORT_UART
        default 1
        range 0 2

    config WD_UART_TX_GPIO
        int "UART TX GPIO"
        depends on WD_TRANSPORT_UART
        default 8
        help
            GPIO16/17 are not broken out on the ESP32-C5-DevKitC-1 (used
            internally by the WROOM-1 module). GPIO8/9 are free, non-
            strapping pins on header J1; wire this to the master's RX pin.

    config WD_UART_RX_GPIO
        int "UART RX GPIO"
        depends on WD_TRANSPORT_UART
        default 9
        help
            Wire this to the master's TX pin. See WD_UART_TX_GPIO for why
            GPIO8/9 were chosen over 16/17 on the DevKitC-1 board.

    config WD_UART_BAUD
        int "UART baud rate"
        depends on WD_TRANSPORT_UART
        default 921600

    config WD_ESPNOW_CHANNEL
        int "ESP-NOW Wi-Fi channel"
        depends on WD_TRANSPORT_ESPNOW
        default 1
        range 1 13
        help
            Fixed channel used for the ESP-NOW control link. Actual Wi-Fi
            scanning temporarily hops to other channels and returns here
            between sweeps.

endmenu
```

## wifi_scanner_c5/sdkconfig.defaults
```kconfig
CONFIG_IDF_TARGET="esp32c5"

CONFIG_ESPTOOLPY_FLASHSIZE_4MB=y
CONFIG_PARTITION_TABLE_CUSTOM=y
CONFIG_PARTITION_TABLE_CUSTOM_FILENAME="partitions.csv"

CONFIG_FREERTOS_HZ=1000

CONFIG_BT_ENABLED=y
CONFIG_BT_NIMBLE_ENABLED=y
CONFIG_BT_NIMBLE_ROLE_OBSERVER=y
```
